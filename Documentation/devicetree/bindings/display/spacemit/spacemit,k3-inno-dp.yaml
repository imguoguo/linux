## Documentation/devicetree/bindings/display/spacemit/spacemit,k3-inno-dp.yaml
```yaml
# SPDX-License-Identifier: (GPL-2.0-only OR BSD-2-Clause)
%YAML 1.2
---
$id: http://devicetree.org/schemas/display/spacemit/spacemit,k3-inno-dp.yaml#
$schema: http://devicetree.org/meta-schemas/core.yaml#

title: SpacemiT K3 Innosilicon DisplayPort / embedded DisplayPort Controller

maintainers:
  - Cody Kang <cody.kang.hk@outlook.com>

description:
  Innosilicon DisplayPort transmit controller integrated in the SpacemiT K3
  SoC. The K3 has two instances, which are the same block and share one
  compatible. An instance acts as embedded DisplayPort or as external
  DisplayPort according to what its output port is wired to, so the binding
  does not distinguish the two.

properties:
  compatible:
    const: spacemit,k3-inno-dp

  reg:
    maxItems: 1

  interrupts:
    maxItems: 1
    description: Link and hot-plug events.

  clocks:
    items:
      - description: Pixel clock, the output of the APMU pixel-clock mux.
      - description:
          Pixel clock generated by the DP PHY PLL. It is one of the inputs of
          that APMU mux, and the one selected while this controller drives a
          display.

  clock-names:
    items:
      - const: pxclk
      - const: pll

  resets:
    maxItems: 1
    description: Controller-wide reset signal.

  phys:
    maxItems: 1
    description: Phandle to the K3 Innosilicon DP PHY.

  phy-names:
    items:
      - const: dp

  mux-controls:
    maxItems: 1
    description:
      One bit in a SoC system-control block that routes a DPU output to this
      controller's transmitter. Only the instance whose transmitter sits
      behind that mux needs it; the other reaches its DPU directly.

  ports:
    $ref: /schemas/graph.yaml#/properties/ports

    properties:
      port@0:
        $ref: /schemas/graph.yaml#/properties/port
        description: Video input from the DPU.

      port@1:
        $ref: /schemas/graph.yaml#/properties/port
        description: Output to the panel or to the DisplayPort connector.

    required:
      - port@0

  aux-bus:
    $ref: /schemas/display/dp-aux-bus.yaml#
    description:
      The DisplayPort AUX bus. Present when the output drives an embedded
      panel, which is described as a child of this node and identifies itself
      over AUX. Absent when the output is a connector.

  phy:
    $ref: /schemas/phy/spacemit,k3-inno-dp-phy.yaml#
    description:
      The DisplayPort PHY. Its registers live inside this controller's
      register window, so it is described here as a child node.

required:
  - compatible
  - reg
  - interrupts
  - clocks
  - clock-names
  - resets
  - phys
  - phy-names
  - ports

additionalProperties: false

examples:
  - |
    #include <dt-bindings/clock/spacemit,k3-clocks.h>
    #include <dt-bindings/reset/spacemit,k3-resets.h>
    #include <dt-bindings/interrupt-controller/irq.h>

    soc {
        #address-cells = <2>;
        #size-cells = <2>;

        edp@cac84000 {
            compatible = "spacemit,k3-inno-dp";
            reg = <0x0 0xcac84000 0x0 0x4000>;
            interrupts = <132 IRQ_TYPE_LEVEL_HIGH>;
            clocks = <&syscon_apmu CLK_APMU_EDP0_PXCLK>, <&edp0_phy>;
            clock-names = "pxclk", "pll";
            resets = <&syscon_apmu RESET_APMU_EDP0>;
            phys = <&edp0_phy>;
            phy-names = "dp";
            mux-controls = <&dpu_tx_mux 0>;

            edp0_phy: phy {
                compatible = "spacemit,k3-inno-dp-phy";
                #phy-cells = <0>;
                #clock-cells = <0>;
                clock-output-names = "edp0_pll_pxclk";
            };

            ports {
                #address-cells = <1>;
                #size-cells = <0>;

                port@0 {
                    reg = <0>;
                    endpoint {
                        remote-endpoint = <&dpu0_out>;
                    };
                };

                port@1 {
                    reg = <1>;
                    endpoint {
                        remote-endpoint = <&panel_in>;
                    };
                };
            };
        };
    };
```

## Documentation/devicetree/bindings/display/spacemit/spacemit,k3-saturn-dpu.yaml
```yaml
# SPDX-License-Identifier: (GPL-2.0-only OR BSD-2-Clause)
%YAML 1.2
---
$id: http://devicetree.org/schemas/display/spacemit/spacemit,k3-saturn-dpu.yaml#
$schema: http://devicetree.org/meta-schemas/core.yaml#

title: SpaceMiT K3 Saturn Display Processing Unit

maintainers:
  - Cody Kang <cody.kang.hk@outlook.com>

description:
  The Saturn DPU is the K3 SoC's display processing unit. It is a SoC-specific
  IP (not derived from VeriSilicon DC8200) and feeds a downstream DisplayPort
  or embedded DisplayPort controller through an OF graph endpoint. The K3
  instantiates two independent DPUs - DPU0 drives the eDP path (register base
  0xc0340000) and DPU1 drives the external DP path (register base 0xc0440000).

properties:
  compatible:
    const: spacemit,k3-saturn-dpu

  reg:
    maxItems: 1

  interrupts:
    minItems: 1
    items:
      - description: online (live-display) IRQ
      - description: offline (writeback) IRQ

  interrupt-names:
    minItems: 1
    items:
      - const: online
      - const: offline

  clocks:
    description:
      Pixel, memory, AXI, escape, and DSC clocks. The K3 hardware also routes
      an AHB-bus clock to DPU0's MIPI DSI block, but mainline does not use
      DSI on this SoC; describe only the five clocks the driver consumes.
    maxItems: 5

  clock-names:
    items:
      - const: pxclk
      - const: mclk
      - const: aclk
      - const: escclk
      - const: dscclk

  resets:
    maxItems: 5

  reset-names:
    items:
      - const: mclk
      - const: lcd
      - const: esc
      - const: aclk
      - const: dsc

  power-domains:
    maxItems: 1

  ports:
    $ref: /schemas/graph.yaml#/properties/ports

    properties:
      port@0:
        $ref: /schemas/graph.yaml#/properties/port
        description: Video output toward DP / eDP controller.

    required:
      - port@0

required:
  - compatible
  - reg
  - interrupts
  - interrupt-names
  - clocks
  - clock-names
  - resets
  - reset-names
  - power-domains
  - ports

additionalProperties: false

examples:
  - |
    #include <dt-bindings/clock/spacemit,k3-clocks.h>
    #include <dt-bindings/pmu/k3_pmu.h>
    #include <dt-bindings/reset/spacemit,k3-resets.h>
    #include <dt-bindings/interrupt-controller/irq.h>

    soc {
        #address-cells = <2>;
        #size-cells = <2>;

        dpu@c0340000 {
            compatible = "spacemit,k3-saturn-dpu";
            reg = <0x0 0xc0340000 0x0 0x54000>;
            interrupts = <90 IRQ_TYPE_LEVEL_HIGH>,
                         <89 IRQ_TYPE_LEVEL_HIGH>;
            interrupt-names = "online", "offline";
            clocks = <&syscon_apmu CLK_APMU_LCD_PXCLK>,
                     <&syscon_apmu CLK_APMU_LCD_MCLK>,
                     <&syscon_apmu CLK_APMU_DPU_ACLK>,
                     <&syscon_apmu CLK_APMU_DSI_ESC>,
                     <&syscon_apmu CLK_APMU_LCD_DSC>;
            clock-names = "pxclk", "mclk", "aclk", "escclk", "dscclk";
            resets = <&syscon_apmu RESET_APMU_LCD_MCLK>,
                     <&syscon_apmu RESET_APMU_LCD>,
                     <&syscon_apmu RESET_APMU_DSI_ESC>,
                     <&syscon_apmu RESET_APMU_DPU_ACLK>,
                     <&syscon_apmu RESET_APMU_LCD_DSCCLK>;
            reset-names = "mclk", "lcd", "esc", "aclk", "dsc";
            power-domains = <&power K3_PMU_LCD0_PWR_DOMAIN>;

            ports {
                #address-cells = <1>;
                #size-cells = <0>;

                port@0 {
                    reg = <0>;
                    endpoint {
                        remote-endpoint = <&edp0_in>;
                    };
                };
            };
        };
    };
```

## Documentation/devicetree/bindings/phy/spacemit,k3-inno-dp-phy.yaml
```yaml
# SPDX-License-Identifier: (GPL-2.0-only OR BSD-2-Clause)
%YAML 1.2
---
$id: http://devicetree.org/schemas/phy/spacemit,k3-inno-dp-phy.yaml#
$schema: http://devicetree.org/meta-schemas/core.yaml#

title: SpacemiT K3 Innosilicon DisplayPort PHY

maintainers:
  - Cody Kang <cody.kang.hk@outlook.com>

description:
  Innosilicon four-lane DisplayPort transmit PHY integrated in the SpacemiT
  K3 SoC, one per DisplayPort controller. Its registers are interleaved with
  the controller's own inside a single register window, so it is described as
  a child of the controller and owns neither a reg nor a reset.

  The PHY provides the pixel clock its PLL generates, which the APMU
  pixel-clock mux takes as one of its inputs.

properties:
  compatible:
    const: spacemit,k3-inno-dp-phy

  "#phy-cells":
    const: 0

  "#clock-cells":
    const: 0

  clock-output-names:
    maxItems: 1

required:
  - compatible
  - "#phy-cells"
  - "#clock-cells"

additionalProperties: false

examples:
  - |
    #include <dt-bindings/clock/spacemit,k3-clocks.h>
    #include <dt-bindings/reset/spacemit,k3-resets.h>
    #include <dt-bindings/interrupt-controller/irq.h>

    soc {
        #address-cells = <2>;
        #size-cells = <2>;

        edp@cac84000 {
            compatible = "spacemit,k3-inno-dp";
            reg = <0x0 0xcac84000 0x0 0x4000>;
            interrupts = <132 IRQ_TYPE_LEVEL_HIGH>;
            clocks = <&syscon_apmu CLK_APMU_EDP0_PXCLK>, <&edp0_phy>;
            clock-names = "pxclk", "pll";
            resets = <&syscon_apmu RESET_APMU_EDP0>;
            phys = <&edp0_phy>;
            phy-names = "dp";
            mux-controls = <&dpu_tx_mux 0>;

            edp0_phy: phy {
                compatible = "spacemit,k3-inno-dp-phy";
                #phy-cells = <0>;
                #clock-cells = <0>;
                clock-output-names = "edp0_pll_pxclk";
            };

            ports {
                #address-cells = <1>;
                #size-cells = <0>;

                port@0 {
                    reg = <0>;
                    endpoint {
                        remote-endpoint = <&dpu0_out>;
                    };
                };

                port@1 {
                    reg = <1>;
                    endpoint {
                        remote-endpoint = <&panel_in>;
                    };
                };
            };
        };
    };
```

## Documentation/devicetree/bindings/power/spacemit,k3-power-controller.yaml
```yaml
# SPDX-License-Identifier: (GPL-2.0-only OR BSD-2-Clause)
%YAML 1.2
---
$id: http://devicetree.org/schemas/power/spacemit,k3-power-controller.yaml#
$schema: http://devicetree.org/meta-schemas/core.yaml#

title: SpaceMiT K3 RPMI Power Domain Controller

maintainers:
  - Cody Kang <cody.kang.hk@outlook.com>

description:
  The K3 SoC routes power-island control to the platform management firmware
  via the RISC-V Platform Management Interface (RPMI), reached through an
  SBI-MPXY mailbox channel. This node aggregates the firmware-exposed
  domains (VPU, GPU, audio, LCD0, LCD1) and presents them to consumers as
  generic power domains identified by the domain IDs in
  dt-bindings/pmu/k3_pmu.h.

properties:
  $nodename:
    pattern: '^power-controller(@.+)?$'

  compatible:
    const: spacemit,k3-power-controller

  mboxes:
    maxItems: 1
    description: |
      SBI-MPXY mailbox channel reaching the RPMI device-power-domain service
      group on the platform management firmware.

  "#power-domain-cells":
    const: 1

  "#address-cells":
    const: 1

  "#size-cells":
    const: 0

patternProperties:
  "^(audio|gpu|lcd|vpu)@[0-9a-f]+$":
    type: object
    description: Per-domain leaf node.

    properties:
      reg:
        maxItems: 1
        description: Domain ID, matching a K3_PMU_*_PWR_DOMAIN constant.

      "#power-domain-cells":
        const: 0

    required:
      - reg
      - "#power-domain-cells"

    additionalProperties: false

required:
  - compatible
  - mboxes
  - "#power-domain-cells"
  - "#address-cells"
  - "#size-cells"

additionalProperties: false

examples:
  - |
    #include <dt-bindings/pmu/k3_pmu.h>

    power-controller {
        compatible = "spacemit,k3-power-controller";
        mboxes = <&mpxy_mbox 0x9 0x0>;
        #power-domain-cells = <1>;
        #address-cells = <1>;
        #size-cells = <0>;

        vpu@0 {
            reg = <K3_PMU_VPU_PWR_DOMAIN>;
            #power-domain-cells = <0>;
        };

        gpu@1 {
            reg = <K3_PMU_GPU_PWR_DOMAIN>;
            #power-domain-cells = <0>;
        };

        audio@2 {
            reg = <K3_PMU_AUD_PWR_DOMAIN>;
            #power-domain-cells = <0>;
        };

        lcd@3 {
            reg = <K3_PMU_LCD0_PWR_DOMAIN>;
            #power-domain-cells = <0>;
        };

        lcd@4 {
            reg = <K3_PMU_LCD1_PWR_DOMAIN>;
            #power-domain-cells = <0>;
        };
    };
```

## Documentation/devicetree/bindings/soc/spacemit/spacemit,k3-qos-syscon.yaml
```yaml
# SPDX-License-Identifier: (GPL-2.0-only OR BSD-2-Clause)
%YAML 1.2
---
$id: http://devicetree.org/schemas/soc/spacemit/spacemit,k3-qos-syscon.yaml#
$schema: http://devicetree.org/meta-schemas/core.yaml#

title: SpacemiT K3 QoS System Controller

maintainers:
  - Cody Kang <cody.kang.hk@outlook.com>

description:
  Small system-control register block of the SpacemiT K3 SoC. It holds the
  one-bit video mux that routes the DPU0 output to the eDP0 transmitter,
  exposed as a generic mmio-mux child.

properties:
  compatible:
    items:
      - const: spacemit,k3-qos-syscon
      - const: syscon
      - const: simple-mfd

  reg:
    maxItems: 1

  mux-controller:
    $ref: /schemas/mux/reg-mux.yaml#

required:
  - compatible
  - reg

additionalProperties: false

examples:
  - |
    system-controller@d4282c00 {
        compatible = "spacemit,k3-qos-syscon", "syscon", "simple-mfd";
        reg = <0xd4282c00 0x200>;

        dpu_tx_mux: mux-controller {
            compatible = "mmio-mux";
            #mux-control-cells = <1>;
            mux-reg-masks = <0x12c 0x100>;
        };
    };
```

## drivers/gpu/drm/spacemit/Kconfig
```kconfig
# SPDX-License-Identifier: GPL-2.0

config DRM_SPACEMIT
	tristate "DRM Support for Spacemit"
	depends on DRM
	select DRM_CLIENT_SELECTION
	select DRM_KMS_HELPER
	select DRM_GEM_SHMEM_HELPER
	select DRM_FBDEV_EMULATION
	select DRM_PANEL
	select VIDEOMODE_HELPERS
	select BACKLIGHT_CLASS_DEVICE
	default n
	help
	  Choose this option if you have a SPACEMIT chipsets.
	  If M is selected the module will be called spacemit-drm.

config SPACEMIT_INNO_DP
	tristate "Spacemit specific extensions for inno dp/edp"
	depends on DRM_SPACEMIT
	select DRM_BRIDGE_CONNECTOR
	select DRM_DISPLAY_HELPER
	select DRM_DISPLAY_DP_HELPER
	select DRM_DISPLAY_DP_AUX_BUS
	default n
	help
	  Support for Spacemit SoC specific extensions for
	  the Innosilicon dp/edp driver.
```

## drivers/soc/spacemit/Kconfig
```kconfig
# SPDX-License-Identifier: GPL-2.0-only

config SOC_SPACEMIT_K3
bool "Spacemit K3 SoC support"
depends on ARCH_SPACEMIT || COMPILE_TEST
default y if ARCH_SPACEMIT
help
  Enable support for Spacemit K3 SoC power domain management.
  This driver provides generic power domain control over RPMI mailbox.

if SOC_SPACEMIT_K3

config SPACEMIT_K3_PM_DOMAIN
tristate "Spacemit K3 power domain driver"
depends on MAILBOX
select PM_GENERIC_DOMAINS
default y
help
  Say Y to enable power domain support for Spacemit K3 SoCs.
  This allows the kernel to manage power domains via RPMI protocol.

endif
```
